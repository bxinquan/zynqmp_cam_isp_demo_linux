## linux-xlnx-xilinx-v2022.1/drivers/staging/allegro/Kconfig
```kconfig
menuconfig ALLEGRO
	tristate "Allegro video codec drivers"
	help
	  Enable Allegro video codec drivers

if ALLEGRO
source "drivers/staging/allegro/al5e/Kconfig"
source "drivers/staging/allegro/al5d/Kconfig"
source "drivers/staging/allegro/dmaproxy/Kconfig"
endif
```

## linux-xlnx-xilinx-v2022.1/drivers/staging/allegro/al5d/Kconfig
```kconfig
config ALLEGRO_VCU_DEC_DRIVER
    tristate "Allegro VCU Decoder"
    depends on HAS_DMA
    select DMA_SHARED_BUFFER
    help
        Enables Allegro VCU driver.
        To compile this driver as a module, choose M here.
```

## linux-xlnx-xilinx-v2022.1/drivers/staging/allegro/al5e/Kconfig
```kconfig
config ALLEGRO_VCU_ENC_DRIVER
    tristate "Allegro VCU Encoder"
    depends on HAS_DMA
    select DMA_SHARED_BUFFER
    help
        Enables Allegro VCU Encoder driver.
        To compile this driver as a module, choose M here.
```

## linux-xlnx-xilinx-v2022.1/drivers/staging/allegro/dmaproxy/Kconfig
```kconfig
config DMAPROXY
        tristate "DMA Proxy client"
        depends on DMA_ENGINE
        select DMA_ENGINE_RAID
        help
          Simple DMA proxy client. Exports APIs to perform Mem2Mem DMA transfer
	  To compile this driver as a module, choose M here.
```
